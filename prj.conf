## CMakeLists.txt
```
# SPDX-License-Identifier: Apache-2.0

cmake_minimum_required(VERSION 3.20.0)
set(OVERLAY_CONFIG "overlay-bt.conf")

#set(mcuboot_CONFIG_BOOT_SIGNATURE_KEY_FILE "\"${CMAKE_CURRENT_LIST_DIR}/signKeyRsa2048.pem\"")

find_package(Zephyr REQUIRED HINTS $ENV{ZEPHYR_BASE})
project(bootloaderTest)

target_sources(app PRIVATE src/main.c src/bluetooth.c)
#FILE(GLOB app_sources src/*.c)
#target_include_directories(app PRIVATE src)
```

## prj.conf
```kconfig
CONFIG_GPIO=y
CONFIG_MAIN_STACK_SIZE=2048

CONFIG_LOG=y


CONFIG_BT=y
#CONFIG_BT_SMP=y
CONFIG_BT_PERIPHERAL=y
CONFIG_BT_DEVICE_APPEARANCE=0
CONFIG_BT_MAX_CONN=1
CONFIG_BT_MAX_PAIRED=0


################## BOOTLOADER and MANAGER ###################

#CONFIG_PCD_APP=y

# Enable mcumgr.
CONFIG_MCUMGR=y


# Some command handlers require a large stack.
CONFIG_SYSTEM_WORKQUEUE_STACK_SIZE=2048


# b0 bootloader enabling
#CONFIG_SECURE_BOOT=y
#CONFIG_BUILD_S1_VARIANT=y

# Ensure an MCUboot-compatible binary is generated.
CONFIG_BOOTLOADER_MCUBOOT=y


# Enable flash operations.
CONFIG_FLASH=y
CONFIG_IMG_ERASE_PROGRESSIVELY=y

# Required by the `taskstat` command.
CONFIG_THREAD_MONITOR=y

# Enable statistics and statistic names.
CONFIG_STATS=y
CONFIG_STATS_NAMES=y

# Enable most core commands.
CONFIG_MCUMGR_CMD_IMG_MGMT=y
CONFIG_MCUMGR_CMD_OS_MGMT=y
CONFIG_MCUMGR_SMP_BT=y

# Enable logging
CONFIG_MCUBOOT_UTIL_LOG_LEVEL_DBG=y


#CONFIG_BOOT_UPGRADE_ONLY=y


CONFIG_NRF53_UPGRADE_NETWORK_CORE=n
CONFIG_MCUBOOT_IMAGE_VERSION="5.6.9+8"
#CONFIG_BOOT_SIGNATURE_KEY_FILE="signKeyRsa2048.pem"
#CONFIG_MCUBOOT_EXTRA_IMGTOOL_ARGS="-E encKeyRsa2048.pem"
```

## overlay-bt.conf
```kconfig
# Allow for large Bluetooth data packets.
CONFIG_BT_L2CAP_TX_MTU=252
CONFIG_BT_BUF_ACL_RX_SIZE=256

# Enable the Bluetooth (unauthenticated) and shell mcumgr transports.
CONFIG_MCUMGR_SMP_BT=y
CONFIG_MCUMGR_SMP_BT_AUTHEN=n
CONFIG_MCUMGR_SMP_SHELL=n

# Enable the LittleFS file system.
CONFIG_FILE_SYSTEM=y
CONFIG_FILE_SYSTEM_LITTLEFS=y

# Add 256 bytes to accommodate upload command (lfs_stat overflows)
CONFIG_SYSTEM_WORKQUEUE_STACK_SIZE=2304

# Enable file system commands
CONFIG_MCUMGR_CMD_FS_MGMT=y
```

## src/main.c
```c
/*
 * Copyright (c) 2016 Intel Corporation
 *
 * SPDX-License-Identifier: Apache-2.0
 */

/*
west sign --tool imgtool --tool-path "C:\NordicNrf\v1.7.0\bootloader\mcuboot\scripts\imgtool.py" --build-dir "C:\MyWorkC\TenniRoboAll\Firmware\NRF52\NrfZephyr\bootloaderTest\build" --header-size 0x200 -S 0x40000 --key "C:\MyWorkC\TenniRoboAll\Firmware\NRF52\NrfZephyr\bootloaderTest\root-rsa-2048.pem" 

sign --key "C:\MyWorkC\TenniRoboAll\Firmware\NRF52\NrfZephyr\bootloaderTest\root-rsa-2048.pem"  --header-size 0x200 -S 0x40000 --align 8 --version 1.3 -E "C:\MyWorkC\TenniRoboAll\Firmware\NRF52\NrfZephyr\bootloaderTest\enc-rsa2048-pub.pem" signed-zephyr-1.3.hex

*/

#include <zephyr.h>
#include <device.h>
#include <devicetree.h>
#include <drivers/gpio.h>
#include "bluetooth.h"

/* 1000 msec = 1 sec */
#define SLEEP_TIME_MS   1000

/* The devicetree node identifier for the "led0" alias. */
#define LED0_NODE DT_ALIAS(led0)

#if DT_NODE_HAS_STATUS(LED0_NODE, okay)
#define LED0	DT_GPIO_LABEL(LED0_NODE, gpios)
#define PIN	DT_GPIO_PIN(LED0_NODE, gpios)
#define FLAGS	DT_GPIO_FLAGS(LED0_NODE, gpios)
#else
/* A build error here means your board isn't set up to blink an LED. */
#error "Unsupported board: led0 devicetree alias is not defined"
#define LED0	""
#define PIN	0
#define FLAGS	0
#endif

void main(void)
{
	const struct device *dev;
	bool led_is_on = true;
	int ret;

	dev = device_get_binding(LED0);
	if (dev == NULL) {
		return;
	}

	ret = gpio_pin_configure(dev, PIN, GPIO_OUTPUT_ACTIVE | FLAGS);
	if (ret < 0) {
		return;
	}

#ifdef CONFIG_MCUMGR_CMD_OS_MGMT
	os_mgmt_register_group();
#endif
#ifdef CONFIG_MCUMGR_CMD_IMG_MGMT
	img_mgmt_register_group();
#endif
#ifdef CONFIG_MCUMGR_CMD_STAT_MGMT
	stat_mgmt_register_group();
#endif

	bluetooth_init();
	while (1) {
		gpio_pin_set(dev, PIN, (int)led_is_on);
		led_is_on = !led_is_on;
		//k_msleep(SLEEP_TIME_MS);
		k_msleep(50);
	}
}
```

## src/bluetooth.c
```c
#define BLE_LOG_LEVEL 4
#include <logging/log.h>
LOG_MODULE_REGISTER(ble_log, BLE_LOG_LEVEL);

#include "bluetooth.h"
//#include <settings/settings.h>




//static struct k_work advertise_work;

#define DEVICE_APPEARENCE 0 // unknown appearence
//static uint8_t appearence_data[] = { 0xff, 0xff };
static uint8_t manufacturer_data[] = { 0xff, 0xff };

static const struct bt_data ad[] = {
    BT_DATA_BYTES(BT_DATA_FLAGS, (BT_LE_AD_GENERAL | BT_LE_AD_NO_BREDR)), 
    //BT_DATA(BT_DATA_NAME_COMPLETE, DEVICE_NAME, DEVICE_NAME_LEN),
    
    //BT_DATA_BYTES(BT_DATA_UUID16_SOME, BT_UUID_TENNIROBO_VAL),

};

/* Set Scan Response data */
static const struct bt_data sd[] = {
    //BT_DATA_BYTES(BT_DATA_UUID16_SOME, BT_UUID_TENNIROBO_VAL),
    BT_DATA(BT_DATA_MANUFACTURER_DATA, manufacturer_data, 2),
    BT_DATA(BT_DATA_NAME_COMPLETE, DEVICE_NAME, DEVICE_NAME_LEN),
};

static struct bt_conn *current_conn;
static struct bt_conn *auth_conn;

static void advertise(struct k_work *work)
{
	int rc;

	bt_le_adv_stop();

    int err = bt_le_adv_start(BT_LE_ADV_CONN, ad, ARRAY_SIZE(ad), sd, ARRAY_SIZE(sd));
    if (err) {
      LOG_ERR("Advertising failed to start (err %d)", err);
      return;
    }

	LOG_INF("Advertising successfully started");
}

static void connected(struct bt_conn *conn, uint8_t err) {
  char addr[BT_ADDR_LE_STR_LEN];

  if (err) {
    LOG_ERR("Connection failed (err %u)", err);
    return;
  }

  bt_addr_le_to_str(bt_conn_get_dst(conn), addr, sizeof(addr));
  LOG_INF("Connected %s", log_strdup(addr));

  current_conn = bt_conn_ref(conn);
}

static void disconnected(struct bt_conn *conn, uint8_t reason) {
  char addr[BT_ADDR_LE_STR_LEN];

  bt_addr_le_to_str(bt_conn_get_dst(conn), addr, sizeof(addr));

  LOG_INF("Disconnected: %s (reason %u)", log_strdup(addr), reason);
  //k_work_submit(&advertise_work);
  
  if (auth_conn) {
    bt_conn_unref(auth_conn);
    auth_conn = NULL;
  }

  if (current_conn) {
    bt_conn_unref(current_conn);
    current_conn = NULL;
  }
}

static struct bt_conn_cb conn_callbacks = {
    .connected = connected,
    .disconnected = disconnected,
#ifdef CONFIG_BT_NUS_SECURITY_ENABLED
    .security_changed = security_changed,
#endif
};

static void bt_receive_cb(struct bt_conn *conn, const uint8_t *const data, uint16_t len) {
  //int err;
  /*
  char addr[BT_ADDR_LE_STR_LEN] = {0};

  bt_addr_le_to_str(bt_conn_get_dst(conn), addr, ARRAY_SIZE(addr));

  LOG_INF("Received data from: %s", log_strdup(addr));
*/
  LOG_HEXDUMP_DBG(data, len, "BT RX");
  //LOG_("Received BT data ");

}


void error(void) {
  while (true) {
    /* Spin for ever */
    k_sleep(K_MSEC(1000));
  }
}

static void bt_ready(int err)
{
	if (err) {
		LOG_ERR("Bluetooth init failed (err %d)", err);
		return;
	}

	LOG_INF("Bluetooth initialized");

	//k_work_submit(&advertise_work);
    err = bt_le_adv_start(BT_LE_ADV_CONN, ad, ARRAY_SIZE(ad), sd, ARRAY_SIZE(sd));
  if (err) {
    LOG_ERR("Advertising failed to start (err %d)", err);
  }
}


void bluetooth_init(void) {
  int err = 0;
  bt_conn_cb_register(&conn_callbacks);
  //k_work_init(&advertise_work, advertise);
  err = bt_enable(bt_ready);

  if (err) {
    error();
  }
  

  if (IS_ENABLED(CONFIG_SETTINGS)) {
	settings_load();
  }

  #ifdef CONFIG_MCUMGR_SMP_BT
    smp_bt_register();
  #endif
  LOG_INF("Bluetooth initialized");


  //  err = bt_le_adv_start(BT_LE_ADV_CONN, ad, ARRAY_SIZE(ad), sd, ARRAY_SIZE(sd));
  //if (err) {
  //  LOG_ERR("Advertising failed to start (err %d)", err);
  //}
}

bool SendDataToBluetoothComms(uint8_t* p_data, uint16_t p_length)
{
  //uint32_t sendResult = bt_comms_send(NULL,  p_data, p_length);
  //LOG_INF("SendDataToBluetooth result = %d", sendResult);
  //return sendResult == 0 ? true : false;

  return true;
}
```

## src/bluetooth.h
```c
#ifndef __ROBOT_BLUETOOTH_
#define __ROBOT_BLUETOOTH_

#include <zephyr/types.h>
#include <zephyr.h>
#include <drivers/uart.h>

#include <device.h>
#include <soc.h>

#include <bluetooth/bluetooth.h>
#include <bluetooth/conn.h>
#include <bluetooth/uuid.h>
#include <bluetooth/gatt.h>
#include <mgmt/mcumgr/smp_bt.h>

//#include "utils.h"

//#define BT_UUID_TENNIROBO_VAL BT_UUID_128_ENCODE(0x4B1F65F5, 0xBA7F, 0x461D, 0x8ACC, 0xCF0A90336294)

#define DEVICE_NAME                         "bootTst"                            /**< Name of device. Will be included in the advertising data. */
#define DEVICE_NAME_LEN (sizeof(DEVICE_NAME) - 1)

//#define HM11_UUID_VAL                      0xFFE0     
//#define BT_UUID_TENNIROBO_VAL                BT_UUID_16_ENCODE(HM11_UUID_VAL)                       // 16 bit UUID - for emulating HM-11





#define APP_BLE_OBSERVER_PRIO               3                                       /**< Application's BLE observer priority. You shouldn't need to modify this value. */
#define APP_BLE_CONN_CFG_TAG                1                                       /**< A tag identifying the SoftDevice BLE configuration. */

#define APP_ADV_INTERVAL                    300                                     /**< The advertising interval (in units of 0.625 ms. This value corresponds to 187.5 ms). */
//#define APP_ADV_DURATION                    18000                                       /**< The advertising duration (180 seconds) in units of 10 milliseconds. */
#define APP_ADV_DURATION                    BLE_GAP_ADV_TIMEOUT_GENERAL_UNLIMITED     // Advertising until app stopps it



#define MIN_CONN_INTERVAL                   MSEC_TO_UNITS(17, UNIT_1_25_MS)        /**< Minimum acceptable connection interval (400 = 0.4 seconds). */
#define MAX_CONN_INTERVAL                   MSEC_TO_UNITS(38, UNIT_1_25_MS)        /**< Maximum acceptable connection interval (600 = 0.65 second). */
#define SLAVE_LATENCY                       0                                       /**< Slave latency. */
#define CONN_SUP_TIMEOUT                    MSEC_TO_UNITS(4000, UNIT_10_MS)         /**< Connection supervisory time-out (4 seconds). */

#define FIRST_CONN_PARAMS_UPDATE_DELAY      5000                                    /**< Time from initiating event (connect or start of notification) to first time sd_ble_gap_conn_param_update is called (5 seconds). */
#define NEXT_CONN_PARAMS_UPDATE_DELAY       30000                                   /**< Time between each call to sd_ble_gap_conn_param_update after the first call (30 seconds). */
#define MAX_CONN_PARAMS_UPDATE_COUNT        3                                       /**< Number of attempts before giving up the connection parameter negotiation. */

#define SEC_PARAM_BOND                      1                                       /**< Perform bonding. */
#define SEC_PARAM_MITM                      0                                       /**< Man In The Middle protection not required. */
#define SEC_PARAM_LESC                      0                                       /**< LE Secure Connections not enabled. */
#define SEC_PARAM_KEYPRESS                  0                                       /**< Keypress notifications not enabled. */
#define SEC_PARAM_IO_CAPABILITIES           BLE_GAP_IO_CAPS_NONE                    /**< No I/O capabilities. */
#define SEC_PARAM_OOB                       0                                       /**< Out Of Band data not available. */
#define SEC_PARAM_MIN_KEY_SIZE              7                                       /**< Minimum encryption key size. */
#define SEC_PARAM_MAX_KEY_SIZE              16                                      /**< Maximum encryption key size. */

#define DEAD_BEEF                           0xDEADBEEF                              /**< Value used as error code on stack dump, can be used to identify stack location on stack unwind. */

#define OSTIMER_WAIT_FOR_QUEUE              2                                       /**< Number of ticks to wait for the timer queue to be ready */






void bluetooth_init(void);
#endif
```
